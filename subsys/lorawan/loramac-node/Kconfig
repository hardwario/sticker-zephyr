## subsys/lorawan/loramac-node/Kconfig
```kconfig
# LoRaWAN loramac-node backend configuration
#
# Copyright (c) 2020 Manivannan Sadhasivam <mani@kernel.org>
# SPDX-License-Identifier: Apache-2.0

if LORA_MODULE_BACKEND_LORAMAC_NODE

config LORAWAN_LORAMAC_NODE
	bool
	default y
	select HAS_SEMTECH_LORAMAC
	imply HAS_SEMTECH_SOFT_SE
	help
	  Hidden config to enable loramac-node backend specific options.

config LORAWAN_SYSTEM_MAX_RX_ERROR
	int "LoRaWAN System Max Rx Error"
	default 20
	help
	  System Max Rx timing error value in ms to be used by LoRaWAN stack
	  for calculating the RX1/RX2 window timing.

config LORAWAN_CONFIRM_TIMEOUT_MS
	int "Maximum wait for a MAC confirm in lorawan_join()/lorawan_send() [ms]"
	default 20000
	range 0 3600000
	help
	  Upper bound on how long lorawan_join() and lorawan_send() wait for
	  the LoRaMac MLME/MCPS confirm after the request has been accepted.
	  LoRaMac normally reports it once the RX windows of the (last)
	  transmission have closed, i.e. within a few seconds for a class A
	  join or unconfirmed uplink. Retransmissions (NbTrans > 1, confirmed
	  uplinks) and duty-cycle delays can stretch that, so keep the value
	  above the longest wait the application legitimately expects.
	  If the confirm never arrives (e.g. a lost radio event), the call
	  returns -ETIMEDOUT instead of blocking the calling thread forever.
	  0 waits forever (the previous behaviour).

config LORAWAN_PUBLIC_NETWORK
	bool "LoRaWAN Public Network"
	default y
	help
	  Enable this option to use a public LoRaWAN network.
	  Disable for private LoRaWAN networks.

endif # LORA_MODULE_BACKEND_LORAMAC_NODE
```
